## board/xunlong/orangepi5-rk3588/Kconfig
```kconfig
if TARGET_ORANGEPI5_RK3588

config SYS_BOARD
	default "orangepi5-rk3588"

config SYS_VENDOR
	default "xunlong"

config SYS_CONFIG_NAME
	default "orangepi5-rk3588"

config BOARD_SPECIFIC_OPTIONS # dummy
	def_bool y

endif
```
